## Kconfig
```kconfig
# SPDX-License-Identifier: GPL-2.0-only

config USB_LSTP
	tristate "LSTP USB adapter support"
	depends on USB
	depends on I2C
	depends on SPI_MASTER
	depends on GPIOLIB
	depends on LEDS_CLASS
	depends on TTY
	select AUXILIARY_BUS
	select GPIOLIB_IRQCHIP
	help
	  This adds support for the Low-Speed Transport Protocol (LSTP)
	  USB adapter. The LSTP adapter exposes firmware-configured I2C, SPI,
	  GPIO, UART, IPMI, and MMIO channels over a single USB interface.

	  This driver can also be built as modules: the core, called lstp,
	  and one module per subsystem driver, called gpio-lstp, leds-lstp,
	  i2c-lstp, spi-lstp, lstp_tty, ipmi-lstp and lstp-mmio.

	  If unsure, say N.

config USB_LSTP_SPI_SPIDEV
	bool "Auto-create spidev devices for LSTP SPI channels"
	depends on USB_LSTP
	depends on SPI_SPIDEV
	help
	  Enable this option to make the lstp module default to creating spidev
	  child devices for SPI channels that do not have firmware-described
	  child devices. spidev binds to them by itself only where its ID table
	  lists "spidev"; mainline needs driver_override.

	  This only sets the compile-time default for the auto_bind_spidev module
	  parameter. The default can still be overridden at module load time.
	  The parameter is deprecated on kernels where SPI host controllers have
	  the new_device attribute.

	  If unsure, say N.

config SEPARATE_LSTP_IPMI_POSTCODES
	bool "Separate LSTP IPMI post code writes to separate miscdevice"
	depends on USB_LSTP
	help
	  Enable this option to route IPMI post code writes to a separate
	  miscdevice instead of the main IPMI message path. Since POST codes
	  do not require a response, this allows faster processing by
	  bypassing the standard IPMI request-response handling.

	  If unsure, say N.

config USB_LSTP_IPMI_MSG_NUM
	bool "Message-number header on LSTP IPMI nodes"
	depends on USB_LSTP
	default y
	help
	  Messages read from and written to an LSTP IPMI device node carry a
	  one-byte message number between the length and the payload, and a
	  response must echo the number of the request it answers. The number
	  exists only on the device node, not in the LSTP protocol, and no
	  other BMC-side IPMI driver has it.

	  Disable this option to drop it. The node then uses the layout of
	  struct ipmi_ssif_msg from the ssif_bmc driver, a length followed by
	  the payload, so that userspace written for ssif_bmc works unchanged.
	  A response answers the request read last, and is dropped once a newer
	  request has arrived.

	  Say Y if userspace parses the message number.
```

## devicetree/bindings/nvidia,lstp-gpio.yaml
```yaml
# SPDX-FileCopyrightText: Copyright (c) 2026 NVIDIA CORPORATION & AFFILIATES. All rights reserved.
# SPDX-License-Identifier: GPL-2.0-only OR BSD-3-Clause
%YAML 1.2
---
$schema: http://devicetree.org/meta-schemas/core.yaml#

title: NVIDIA LSTP GPIO Channel

description: |
  GPIO controller channel on an NVIDIA LSTP USB device.

  The LSTP GPIO channel registers as a Linux GPIO chip.  The number of
  GPIO lines and their firmware-default names/directions are reported by
  the device firmware at probe time.

  DT properties such as gpio-line-names override the firmware-reported
  pin names.  The gpio-controller and #gpio-cells properties enable
  phandle references from consumers (e.g. gpio-leds, gpio-keys).

  The channel is also an interrupt controller.  Consumers may either
  reference a line with a *-gpios phandle and call gpiod_to_irq(), or use
  the interrupts-extended / interrupt-parent + interrupts idiom via the
  interrupt-controller and #interrupt-cells properties.  An interrupt line
  must be an input; the firmware-reported pin direction is authoritative
  and is not changed at runtime.

  GPIO hog child nodes are supported for boot-time pin configuration.

  Note: because the GPIO controller sits behind USB, all operations are
  inherently sleeping (can_sleep = true).  Consumers that require
  non-sleeping GPIO access cannot use this controller.

properties:
  compatible:
    const: nvidia,lstp-gpio

  reg:
    description: LSTP channel ID as reported by firmware.
    maxItems: 1

  gpio-controller: true

  "#gpio-cells":
    const: 2
    description: |
      Two cells: pin number and flags.
      Cell 0: GPIO pin offset (0-based).
      Cell 1: GPIO flags (e.g. GPIO_ACTIVE_LOW).

  interrupt-controller: true

  "#interrupt-cells":
    const: 2
    description: |
      Two cells: GPIO line offset and trigger flags.
      Cell 0: GPIO line offset (0-based), same numbering as #gpio-cells.
      Cell 1: Trigger flags (see <dt-bindings/interrupt-controller/irq.h>).

  gpio-line-names:
    description: |
      Optional list of human-readable names for each GPIO line.
      Overrides the firmware-reported pin names.  The number of entries
      must not exceed the number of GPIO lines reported by firmware.
    minItems: 1
    maxItems: 255

  ngpios:
    description: |
      Override the number of GPIO lines.  Normally the pin count is
      determined by firmware; this property is only needed if the DT
      must constrain it further.
    minimum: 1
    maximum: 255

patternProperties:
  "^.+-hog(-[0-9]+)?$":
    type: object
    required:
      - gpio-hog
      - gpios

    properties:
      gpio-hog: true
      gpios:
        description: Pin offset and flags for the hog.
      output-high: true
      output-low: true
      input: true
      line-name:
        description: Consumer name shown in /sys/kernel/debug/gpio.

    additionalProperties: false

dependentRequired:
  interrupt-controller: ["#interrupt-cells"]
  "#interrupt-cells": [interrupt-controller]

required:
  - compatible
  - reg
  - gpio-controller
  - "#gpio-cells"

additionalProperties: false

examples:
  - |
    /* Minimal: let firmware define pin count and names */
    channel@3 {
        compatible = "nvidia,lstp-gpio";
        reg = <3>;
        gpio-controller;
        #gpio-cells = <2>;
    };
  - |
    /* Override pin names and add a hog */
    gpio_ch: channel@3 {
        compatible = "nvidia,lstp-gpio";
        reg = <3>;
        gpio-controller;
        #gpio-cells = <2>;
        gpio-line-names = "STATUS_LED", "ALERT_INT";

        led-hog {
            gpio-hog;
            gpios = <0 0>;
            output-high;
            line-name = "status-led-hog";
        };
    };
  - |
    #include <dt-bindings/gpio/gpio.h>
    #include <dt-bindings/interrupt-controller/irq.h>

    /* Act as an interrupt controller for a consumer via interrupts-extended */
    gpio_irq_ch: channel@3 {
        compatible = "nvidia,lstp-gpio";
        reg = <3>;
        gpio-controller;
        #gpio-cells = <2>;
        interrupt-controller;
        #interrupt-cells = <2>;
    };

    alert-consumer {
        compatible = "gpio-keys";

        alert {
            label = "alert";
            linux,code = <143>; /* KEY_WAKEUP */
            /* Line 1 as a falling-edge interrupt source */
            interrupts-extended = <&gpio_irq_ch 1 IRQ_TYPE_EDGE_FALLING>;
        };
    };
```
